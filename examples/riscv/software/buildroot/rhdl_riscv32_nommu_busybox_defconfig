## examples/riscv/software/buildroot/rhdl_riscv32_nommu_busybox_defconfig
```kconfig
BR2_riscv=y
BR2_riscv_custom=y
BR2_RISCV_32=y
# BR2_RISCV_USE_MMU is not set
BR2_RISCV_ISA_RVI=y
BR2_RISCV_ISA_RVM=y
BR2_RISCV_ISA_RVA=y
# BR2_RISCV_ISA_RVF is not set
# BR2_RISCV_ISA_RVD is not set
# BR2_RISCV_ISA_RVC is not set
# BR2_RISCV_ISA_RVV is not set
BR2_RISCV_ABI_ILP32=y
# BR2_RISCV_ABI_ILP32F is not set
# BR2_RISCV_ABI_ILP32D is not set
BR2_TOOLCHAIN_BUILDROOT_UCLIBC=y
BR2_STATIC_LIBS=y
# BR2_TARGET_GENERIC_GETTY is not set
BR2_INIT_BUSYBOX=y
BR2_PACKAGE_BUSYBOX=y
BR2_PACKAGE_BUSYBOX_CONFIG="package/busybox/busybox-minimal.config"
BR2_ROOTFS_OVERLAY="/workspace/software/buildroot/overlay"
BR2_SYSTEM_DHCP=""
BR2_TARGET_ROOTFS_CPIO=y
BR2_TARGET_ROOTFS_CPIO_NONE=y
BR2_TARGET_ROOTFS_EXT2=y
BR2_TARGET_ROOTFS_EXT2_2=y
BR2_TARGET_ROOTFS_EXT2_2r1=y
BR2_TARGET_ROOTFS_EXT2_SIZE="16M"
BR2_TARGET_ROOTFS_EXT2_NONE=y
```

## examples/riscv/software/linux_configs/tiny_busybox_buildroot_defconfig
```kconfig
BR2_riscv=y
BR2_riscv_g=y
BR2_RISCV_32=y
BR2_RISCV_USE_MMU=y
BR2_RISCV_ABI_ILP32D=y
BR2_TOOLCHAIN_EXTERNAL=y
BR2_TOOLCHAIN_EXTERNAL_BOOTLIN=y
BR2_TOOLCHAIN_EXTERNAL_BOOTLIN_RISCV32_ILP32D_UCLIBC_STABLE=y
BR2_STATIC_LIBS=y
# BR2_TARGET_GENERIC_GETTY is not set
BR2_INIT_BUSYBOX=y
BR2_PACKAGE_BUSYBOX=y
BR2_PACKAGE_BUSYBOX_CONFIG="/workspace/software/linux_configs/tiny_busybox_buildroot.config"
BR2_ROOTFS_OVERLAY="/workspace/software/linux_configs/overlay"
BR2_SYSTEM_DHCP=""
BR2_TARGET_ROOTFS_CPIO=y
BR2_TARGET_ROOTFS_CPIO_NONE=y
# BR2_TARGET_ROOTFS_EXT2 is not set
```
